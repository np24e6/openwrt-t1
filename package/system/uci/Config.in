## package/system/uci/Config.in
```kconfig
if PACKAGE_libuci

config UCI_LOG_SUPPORT
	bool "Enable UCI logging support"
	default n

endif
```

## package/teltonika/libs/libbrand/Config.in
```kconfig
config TLT_VERSIONING_PREFIX
	depends on PACKAGE_libbrand-versioning
	string "PREFIX"
	help
		Teltonika VERSIONING PREFIX
	default RUTM if TARGET_ramips_mt7621_DEVICE_teltonika_rutm
	default ATRM50 if TARGET_ramips_mt7621_DEVICE_teltonika_atrm50
	default RUTC if TARGET_mediatek_mt7981_DEVICE_teltonika_rutc
	default RUTX if TARGET_ipq40xx_generic_DEVICE_teltonika_rutx
	default TRB2 if TARGET_ath79_24kc_DEVICE_teltonika_trb2xx
	default TRB2M if TARGET_ramips_mt76x8_DEVICE_teltonika_trb2m
	default RUT2M if TARGET_ramips_mt76x8_DEVICE_teltonika_rut2m
	default RUT206 if TARGET_ramips_mt76x8_DEVICE_teltonika_rut206
	default TAP100 if TARGET_ramips_mt76x8_DEVICE_teltonika_tap100
	default TAP200 if TARGET_ramips_mt7621_DEVICE_teltonika_tap200
	default TCR1 if TARGET_ath79_24kc_DEVICE_teltonika_tcr1xx
	default RUT9M if TARGET_ramips_mt76x8_DEVICE_teltonika_rut9m
	default RUT14X if TARGET_ramips_mt76x8_DEVICE_teltonika_rut14x
	default RUT30X if TARGET_ath79_24kc_DEVICE_teltonika_rut30x
	default RUT301 if TARGET_ramips_mt76x8_DEVICE_teltonika_rut301
	default RUT36X if TARGET_ath79_24kc_DEVICE_teltonika_rut36x
	default RUT361 if TARGET_ramips_mt76x8_DEVICE_teltonika_rut361
	default OTD140 if TARGET_ramips_mt76x8_DEVICE_teltonika_otd140
	default OTD500 if TARGET_ramips_mt7621_DEVICE_teltonika_otd500
	default TRB500 if TARGET_sdxprairie_DEVICE_teltonika_trb500
	default TRB501 if TARGET_sdxlemur_DEVICE_teltonika_trb501
	default TRB16 if TARGET_sdxnightjar
	default TRB1 if TARGET_mdm9x07
	default X86-64 if TARGET_x86_64_DEVICE_teltonika_x86_64

config TLT_VERSIONING_CLIENT
	depends on PACKAGE_libbrand-versioning
	string "Client"
	help
		Client code, two decimals
	default 00

config TLT_VERSIONING_MANUAL_ENABLE
	depends on PACKAGE_libbrand-versioning
	bool "Manual firmware versioning"
	help
		Use manual firmware versioning
	default n

config TLT_VERSIONING_RELEASE
	depends on PACKAGE_libbrand-versioning && TLT_VERSIONING_MANUAL_ENABLE
	string "Release/Test"
	help
		"R" for release, "T" for test version
	default T

config TLT_VERSIONING_BRANCH_PREFIX
	depends on PACKAGE_libbrand-versioning
	string "Define branch prefix string"
	help
		Define branch prefix, "-" for auto
	default -

config TLT_VERSIONING_MAJOR
	depends on PACKAGE_libbrand-versioning && TLT_VERSIONING_MANUAL_ENABLE
	string "Major"
	help
		Major version number, two decimals
	default 00

config TLT_VERSIONING_MINOR
	depends on PACKAGE_libbrand-versioning && TLT_VERSIONING_MANUAL_ENABLE
	string "Minor"
	help
		Minor version number, two decimals
	default 00

config TLT_VERSIONING_PATCH_ENABLE
	depends on PACKAGE_libbrand-versioning && TLT_VERSIONING_MANUAL_ENABLE
	bool "Add patch version to version string"
	help
		Add Patch version number
	default n

config TLT_VERSIONING_PATCH
	depends on PACKAGE_libbrand-versioning && TLT_VERSIONING_MANUAL_ENABLE && TLT_VERSIONING_PATCH_ENABLE
	string "Patch"
	help
		Patch version number
	default 0
```

## package/teltonika/mobifd/Config.in
```kconfig
config MOBIFD_DEBUG
	bool "Enable debuging"
	depends on PACKAGE_mobifd
	default n
    help
        Enables deep debuging

config MOBIFD_WHITELIST_AFRICA
	bool "Module works only with africa operators (RUT200)"
	depends on PACKAGE_mobifd
	default n
    help
        Module works only with africa operators (RUT200)

config MOBIFD_WHITELIST_AFRICA_EU
	bool "Module works with africa and EU operators (RUT200)"
	depends on PACKAGE_mobifd
	default n
    help
        Module works with africa and EU operators (RUT200)
```

## target/linux/ipq40xx/Config.in
```kconfig
menu "Target options and settings"
depends on TARGET_ipq40xx

config DEFAULT_TARGET_OPTIONS
	bool
	default y
	select KERNEL_MTD_UBI
	select KERNEL_MTD_UBI_BLOCK

endmenu
```
